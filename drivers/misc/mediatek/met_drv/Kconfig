## drivers/misc/mediatek/met_drv/Kconfig
```kconfig
config MTK_MET_MEM_ALLOC
	bool "MET driver use dynamic alloc buffer"
	help
	  MET is a MediaTek profiling tool, it need buf to store log msg
	  set N to use reserve 4MB buffer
	  set Y to use dynamic alloc buffer
	  If unsure,
	  Set N to use reserve 4MB buffer

config MTK_MET_BUILT_IN
        bool "Build MET module in kernel"
        help
	  This will build the MET driver and the corresponding componenets
	  into the kernel.
	  If unsure say n
```
